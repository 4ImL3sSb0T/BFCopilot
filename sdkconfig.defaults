## src/app/Kconfig.projbuild
```kconfig
menu "BFCopilot app"

    config BF_NET_TEST_ENABLED
        bool "Enable BSP network test task"
        depends on BF_WIFI_ENABLED
        default n
        help
            Start TCP and UDP echo endpoints after Wi-Fi connects. The task is intended for
            bring-up and must be disabled in flight firmware.

    config BF_NET_TEST_TCP_PORT
        int "Network test TCP server port"
        depends on BF_NET_TEST_ENABLED
        range 1 65535
        default 3333

    config BF_NET_TEST_UDP_PORT
        int "Network test UDP server port"
        depends on BF_NET_TEST_ENABLED
        range 1 65535
        default 3334

    config BF_NET_TEST_CLIENT_ENABLED
        bool "Enable network test TCP client"
        depends on BF_NET_TEST_ENABLED
        default n
        help
            Connect to a host-side TCP echo listener and verify the board's client path.

    config BF_NET_TEST_REMOTE_HOST
        string "Network test TCP client host"
        depends on BF_NET_TEST_CLIENT_ENABLED
        default "192.168.137.1"

    config BF_NET_TEST_REMOTE_PORT
        int "Network test TCP client port"
        depends on BF_NET_TEST_CLIENT_ENABLED
        range 1 65535
        default 3335

endmenu
```

## src/bsp/Kconfig
```kconfig
menu "BFCopilot BSP"

    config BF_WIFI_ENABLED
        bool "Enable Wi-Fi station (bench/link)"
        default n
        help
            打开后 bsp_wifi 才会初始化 Wi-Fi 协议栈并连接 AP。
            默认关闭：无线链路应在安全状态机和整机联调之后再启用。

    config BF_WIFI_SSID
        string "Wi-Fi SSID"
        depends on BF_WIFI_ENABLED
        default ""
        help
            要加入的 2.4 GHz AP 名称，最多 32 字节。

            不要把真实凭据写进 sdkconfig.defaults（该文件会进版本库）。
            用 idf.py menuconfig 填到 sdkconfig（已 gitignore），
            或者另建一个 gitignore 的 local.defaults 并通过
            -D SDKCONFIG_DEFAULTS="sdkconfig.defaults;local.defaults" 引入。

    config BF_WIFI_PASSWORD
        string "Wi-Fi password (empty = open network)"
        depends on BF_WIFI_ENABLED
        default ""
        help
            WPA2/WPA3 口令，最多 64 字节；留空表示开放网络。
            同样只放到 sdkconfig 或本地 defaults，不要提交。

    config BF_WIFI_CONNECT_TIMEOUT_MS
        int "Connect timeout (ms)"
        depends on BF_WIFI_ENABLED
        range 1000 120000
        default 15000

endmenu
```

## src/driver/Kconfig
```kconfig
menu "BFCopilot radio"
config BF_RADIO_ENABLED
    bool "Enable explicitly provisioned encrypted ESP-NOW peer"
    default n
config BF_RADIO_CHANNEL
    int "Fixed Wi-Fi channel"
    range 1 11
    default 6
config BF_RADIO_PEER
    string "Peer station MAC (12 hexadecimal digits)"
    default ""
config BF_RADIO_PMK
    string "PMK (32 hexadecimal digits)"
    default ""
config BF_RADIO_LMK
    string "LMK (32 hexadecimal digits)"
    default ""
endmenu

menu "BFCopilot Wi-Fi direct link"
config BF_WIFI_LINK_ENABLED
    bool "Enable Wi-Fi + UDP control link (bench)"
    default n
    help
        Flight controller accepts the same 60-byte control frames over UDP,
        either as an access point or as a station on an existing one. Mutually
        exclusive with the ESP-NOW peer. There is no application-layer
        authentication: bench/indoor only, never a flight-worthy link.

choice BF_WIFI_LINK_MODE
    prompt "Link mode"
    default BF_WIFI_LINK_MODE_STA
    depends on BF_WIFI_LINK_ENABLED
    config BF_WIFI_LINK_MODE_AP
        bool "Flight controller runs its own access point"
    config BF_WIFI_LINK_MODE_STA
        bool "Flight controller joins an existing access point"
endchoice

config BF_WIFI_STA_SSID
    string "Upstream SSID"
    default ""
    depends on BF_WIFI_LINK_ENABLED && BF_WIFI_LINK_MODE_STA

config BF_WIFI_STA_PASSWORD
    string "Upstream WPA2 passphrase (8..63 characters; empty = open)"
    default ""
    depends on BF_WIFI_LINK_ENABLED && BF_WIFI_LINK_MODE_STA

config BF_WIFI_AP_SSID
    string "Access point SSID"
    default "BFCopilot"
    depends on BF_WIFI_LINK_ENABLED && BF_WIFI_LINK_MODE_AP

config BF_WIFI_AP_PASSWORD
    string "Access point WPA2 passphrase (8..63 characters; empty = open)"
    default ""
    depends on BF_WIFI_LINK_ENABLED && BF_WIFI_LINK_MODE_AP

config BF_WIFI_AP_CHANNEL
    int "Wi-Fi channel"
    range 1 11
    default 6
    depends on BF_WIFI_LINK_ENABLED && BF_WIFI_LINK_MODE_AP

config BF_WIFI_LINK_PORT
    int "UDP control port"
    range 1024 65535
    default 3335
    depends on BF_WIFI_LINK_ENABLED

config BF_WIFI_LINK_BENCH_TIMING
    bool "Relax control timing for bench Wi-Fi (300 ms TTL / 500 ms lease)"
    default n
    depends on BF_WIFI_LINK_ENABLED
    help
        Allow hotspot scheduling jitter during supervised bench tests.
        This delays control-loss protection. Keep disabled for strict timing.
        Emergency stop processing remains immediate.
endmenu
```

## test/bench/main/Kconfig.projbuild
```kconfig
menu "BFCopilot hardware test firmware"

config BF_WIFI_STA_SSID
    string "SSID to join"
    default ""

config BF_WIFI_STA_PASSWORD
    string "Passphrase for that SSID (empty for an open network)"
    default ""

config BF_BENCH_PORT
    int "TCP port serving the hardware console"
    range 1024 65535
    default 3333

endmenu
```
